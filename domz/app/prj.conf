## CMakeLists.txt
```
# SPDX-License-Identifier: Apache-2.0
#
# DomZ - the Zephyr guest (DomU) of the RPi5 SoDeV cockpit.
#
# Built by the moulin `domz` component (rpi5-sodev.yaml) as
#   west build -b xenvm -d build-domz-rpi5 ../domz/app
# from the zephyr-domz/ west workspace, so this application lives OUTSIDE the
# workspace on purpose: it is versioned with the rest of this repository while
# the Zephyr tree itself stays a pristine west checkout.
cmake_minimum_required(VERSION 3.20.0)

find_package(Zephyr REQUIRED HINTS $ENV{ZEPHYR_BASE})
project(domz)

target_sources(app PRIVATE src/main.c)
```

## Kconfig
```
# SPDX-License-Identifier: Apache-2.0
mainmenu "DomZ (Zephyr DomU) application"

config DOMZ_HEARTBEAT_INTERVAL_MS
	int "Interval of the liveness log line (ms), 0 to disable"
	default 10000
	help
	  DomZ has no display and no network, so a periodic log line on the Xen
	  PV console (`xl console DomZ`) is how a bench operator sees that the
	  domain is alive.

source "Kconfig.zephyr"
```

## prj.conf
```kconfig
# SPDX-License-Identifier: Apache-2.0
# DomZ: unprivileged Zephyr guest (DomU) under Xen 4.22 on Raspberry Pi 4/5.
#
# The board (xenvm) already supplies the guest memory map, GICv2, the ARM generic
# timer with CONFIG_TIMER_READS_ITS_FREQUENCY_AT_RUNTIME=y (so the 8.32 MHz
# default in soc/arm64/xenvm/Kconfig.defconfig does not have to match BCM2712's
# 54 MHz counter) and the Xen PV console node. What is left here is the Xen guest
# support itself plus a small-footprint logging setup: the domain gets 16 MiB.

# NOTE: no CONFIG_XEN here. It is a promptless symbol
# (arch/arm64/core/xen/Kconfig): `default y` gated on ARMV8_A and
# DT_HAS_XEN_XEN_ENABLED, so the xen,xen `hypervisor` node in xenvm.dts already
# turns it on - and assigning it in a .conf file is a hard Kconfig error
# ("assigned in a configuration file, but is not directly user-configurable").
# The same applies to the PV console driver that `xl console DomZ` attaches to:
# UART_XEN_HVC is `default y` once the xen,hvc-uart node is enabled and
# XEN && !XEN_DOM0 holds, which is exactly this configuration.

CONFIG_LOG=y
# Minimal mode: no log thread, no deferred buffers. The Zephyr Dom0 application
# in this workspace uses the same mode for the same reason (memory).
CONFIG_LOG_MODE_MINIMAL=y
CONFIG_PRINTK=y

CONFIG_MAIN_STACK_SIZE=4096
CONFIG_HEAP_MEM_POOL_SIZE=16384

# NOTE: no MP_*_NUM_CPUS override here. xenvm.dts declares a single cpu@0 and
# domz.cfg gives the domain one vCPU, so the board default already matches; the
# symbol was renamed (MP_NUM_CPUS -> MP_MAX_NUM_CPUS) around Zephyr 3.5 and
# hard-coding either name would break on the other side of that rename.
```

## src/main.c
```c
/*
 * SPDX-License-Identifier: Apache-2.0
 *
 * DomZ - Zephyr running as an unprivileged Xen guest (DomU).
 *
 * Board-independent: the guest board is `xenvm`, so this same image is valid under
 * Xen on a Raspberry Pi 5 and on a Raspberry Pi 4.
 *
 * The domain is created by the xl toolstack (DomD in the Zephyr-Dom0 flavour,
 * Dom0 in the thin-Linux flavour) from /etc/xen/domz.cfg, which loads this
 * image from SD p1 as zephyr-domz.bin. It has no display, no block device and
 * no network: its console is the Xen PV console, reachable with
 * `xl console DomZ` from the toolstack domain.
 */

#include <zephyr/kernel.h>
#include <zephyr/logging/log.h>
#include <zephyr/sys/util.h>
#include <version.h>

LOG_MODULE_REGISTER(domz, LOG_LEVEL_INF);

int main(void)
{
	LOG_INF("DomZ up: Zephyr " KERNEL_VERSION_STRING " as Xen DomU (AGL SoDeV)");
	LOG_INF("DomZ: board=%s soc=%s", CONFIG_BOARD, CONFIG_SOC);

	if (CONFIG_DOMZ_HEARTBEAT_INTERVAL_MS <= 0) {
		return 0;
	}

	while (true) {
		k_msleep(CONFIG_DOMZ_HEARTBEAT_INTERVAL_MS);
		LOG_INF("DomZ alive, uptime %u s", (unsigned int)(k_uptime_get() / 1000));
	}

	return 0;
}
```
