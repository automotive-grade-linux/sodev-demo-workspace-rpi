## meta-rpi-sodev/meta-xt-common/meta-xt-domu/conf/machine/virtio-armv8-xt.conf
```bitbake
#@TYPE: Machine
#@NAME: virtio armv8 machine
#@DESCRIPTION: Machine configuration for running a virtio armv8

require conf/machine/include/arm/arch-arm64.inc

KERNEL_IMAGETYPE = "Image"
IMAGE_FSTYPES += " tar.bz2 ext4"

PREFERRED_PROVIDER_virtual/kernel = "linux-virtio-armv8"
LINUXLIBCVERSION = "6.8%"
```
