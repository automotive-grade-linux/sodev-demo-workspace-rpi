/*
 * Copyright (c) 2024 EPAM systems
 *
 * SPDX-License-Identifier: Apache-2.0
*/
/dts-v1/;
/plugin/;

&rp1 {
	usb@200000 {
		reg = <0xc0 0x40200000 0x00 0x100000>;
		compatible = "snps,dwc3";
		dr_mode = "host";
		usb3-lpm-capable;
		snps,axi-pipe-limit = [08];
		snps,dis_rxdet_inp3_quirk;
		snps,enhanced-nak-fs-quirk;
		snps,parkmode-disable-ss-quirk;
		snps,parkmode-disable-hs-quirk;
		snps,parkmode-disable-fsls-quirk;
		snps,tx-max-burst-prd = <0x08>;
		snps,tx-thr-num-pkt-prd = <0x02>;
		interrupts = <0x1f 0x01>;
		status = "okay";
	};

	usb@300000 {
		reg = <0xc0 0x40300000 0x00 0x100000>;
		compatible = "snps,dwc3";
		dr_mode = "host";
		usb3-lpm-capable;
		snps,axi-pipe-limit = [08];
		snps,dis_rxdet_inp3_quirk;
		snps,enhanced-nak-fs-quirk;
		snps,parkmode-disable-ss-quirk;
		snps,parkmode-disable-hs-quirk;
		snps,parkmode-disable-fsls-quirk;
		snps,tx-max-burst-prd = <0x08>;
		snps,tx-thr-num-pkt-prd = <0x02>;
		interrupts = <0x24 0x01>;
		status = "okay";
	};
};
